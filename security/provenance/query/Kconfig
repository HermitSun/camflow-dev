## security/provenance/query/Kconfig
```kconfig
config SECURITY_PROVENANCE_QUERY
	bool "CamQuery - CamFlow Query Framework"
	depends on SECURITY_PROVENANCE
	default y
	help
	  This option turn on the in-kernel query framework.

	  If you are unsure how to answer this question, answer Y.

config SECURITY_PROVENANCE_QUERY_TRACKING
	bool "CamQuery - tracking query"
	depends on SECURITY_PROVENANCE_QUERY
	default y
	help
	  Query supporting tracking.

	  If you are unsure how to answer this question, answer Y.
```
